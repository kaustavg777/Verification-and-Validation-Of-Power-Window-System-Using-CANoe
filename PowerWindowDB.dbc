VERSION ""

NS_ :

BS_:

BU_: ECU2 ECU1

BO_ 0 WindowStatus: 1 ECU1
 SG_ WindowOnOFF : 0|1@1+ (1,0) [0|1] "" Vector__XXX

BA_DEF_  "BusType" STRING ;
BA_DEF_DEF_  "BusType" "CAN";
